## Nordic/NRF52833/demo/usb_cdc/build/Kconfig/Kconfig.shield
```kconfig
osource "e:/2023/tautek/samples/tautek_bt833_demo/usb_cdc/boards/shields/*/Kconfig.shield"
osource "C:/ncs/v2.4.2/nrf/boards/shields/*/Kconfig.shield"
```

## Nordic/NRF52833/demo/usb_cdc/build/Kconfig/Kconfig.shield.defconfig
```kconfig
osource "e:/2023/tautek/samples/tautek_bt833_demo/usb_cdc/boards/shields/*/Kconfig.defconfig"
osource "C:/ncs/v2.4.2/nrf/boards/shields/*/Kconfig.defconfig"
```

## Nordic/NRF5340/Demo/wifi/build/Kconfig/Kconfig.shield
```kconfig
osource "e:/2023/tautek/samples/nrf5340/wifi/boards/shields/*/Kconfig.shield"
osource "C:/ncs/v2.4.2/nrf/boards/shields/*/Kconfig.shield"
```

## Nordic/NRF5340/Demo/wifi/build/Kconfig/Kconfig.shield.defconfig
```kconfig
osource "e:/2023/tautek/samples/nrf5340/wifi/boards/shields/*/Kconfig.defconfig"
osource "C:/ncs/v2.4.2/nrf/boards/shields/*/Kconfig.defconfig"
```
