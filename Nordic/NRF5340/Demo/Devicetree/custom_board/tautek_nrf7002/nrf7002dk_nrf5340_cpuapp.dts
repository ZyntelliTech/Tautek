/*
 * Copyright (c) 2022 Nordic Semiconductor ASA
 *
 * SPDX-License-Identifier: LicenseRef-Nordic-5-Clause
 */

/dts-v1/;
#include <nordic/nrf5340_cpuapp_qkaa.dtsi>
#include "nrf5340_cpuapp_common.dts"
#include "nrf7002dk_nrf5340_cpuapp-pinctrl.dtsi"

/ {
	model = "Nordic NRF7002 DK NRF5340 Application";
	compatible = "nordic,nrf7002-dk-nrf5340-cpuapp";

	chosen {
		zephyr,sram = &sram0_image;
		zephyr,flash = &flash0;
		zephyr,code-partition = &slot0_partition;
		zephyr,sram-secure-partition = &sram0_s;
		zephyr,sram-non-secure-partition = &sram0_ns;
	};
};

&arduino_header {
	gpio-map = <0 0 &gpio0 4 0>,
			   <1 0 &gpio0 5 0>,
			   <2 0 &gpio0 6 0>,
			   <3 0 &gpio0 7 0>,
			   <4 0 &gpio0 25 0>,
			   <5 0 &gpio0 26 0>,
			   <6 0 &gpio1 0 0>,
			   <7 0 &gpio1 1 0>,
			   <8 0 &gpio1 4 0>,
			   <9 0 &gpio1 5 0>,
			   <10 0 &gpio1 6 0>,
			   <11 0 &gpio1 7 0>,
			   <12 0 &gpio1 8 0>,
			   <13 0 &gpio1 9 0>,
			   <14 0 &gpio1 10 0>,
			   <15 0 &gpio1 11 0>,
			   <16 0 &gpio1 12 0>,
			   <17 0 &gpio1 13 0>,
			   <18 0 &gpio1 14 0>,
			   <19 0 &gpio1 15 0>,
			   <20 0 &gpio1 2 0>,
			   <21 0 &gpio1 3 0>;
};
